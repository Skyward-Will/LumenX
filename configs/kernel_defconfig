## configs/kernel_defconfig
```kconfig
# LumenX 内核默认配置 (x86_64)
CONFIG_64BIT=y
CONFIG_X86_64=y
CONFIG_BLK_DEV_INITRD=y
CONFIG_EFI=y
CONFIG_EFI_STUB=y
CONFIG_SYSFS_DEPRECATED=n
CONFIG_MODULES=y
CONFIG_MODULE_UNLOAD=y
CONFIG_PCI=y
CONFIG_NET=y
CONFIG_BLK_DEV_SD=y
CONFIG_EXT4_FS=y
CONFIG_VT=y
CONFIG_TTY=y
CONFIG_FB=y
CONFIG_FRAMEBUFFER_CONSOLE=y
CONFIG_LOGO=y
CONFIG_DEBUG_KERNEL=n  # 生产环境关闭调试
CONFIG_SERIAL_8250=y
CONFIG_SERIAL_8250_CONSOLE=y
CONFIG_CMDLINE_BOOL=y
CONFIG_CMDLINE="root=/dev/sda1 quiet splash"

# 文件系统支持
CONFIG_BTRFS_FS=y
CONFIG_XFS_FS=y
CONFIG_FAT_FS=y
CONFIG_NTFS_FS=y

# 网络驱动 (常见网卡)
CONFIG_E1000=y
CONFIG_E1000E=y
CONFIG_R8169=y

# 图形化界面依赖
CONFIG_DRM=y
CONFIG_DRM_I915=y
CONFIG_DRM_AMDGPU=y
CONFIG_INPUT_MOUSE=y
CONFIG_INPUT_KEYBOARD=y
```
